#include "MKL25Z4.h"
#include "Serial.h"

void Serial_Init()
{
	uint16_t bd_div = ((SystemCoreClock/2)/(9600*4));

	SET_BIT(SIM_BASE_PTR->SOPT2, SIM_SOPT2_PLLFLLSEL_MASK | SIM_SOPT2_UART0SRC(1));

	SET_BIT(SIM_BASE_PTR->SCGC4, SIM_SCGC4_UART0_MASK);
	SET_BIT(SIM_BASE_PTR->SCGC5, SIM_SCGC5_PORTA_MASK);

	SET_BIT(PORTA_BASE_PTR->PCR[1], PORT_PCR_MUX(2)); /*RX*/
	SET_BIT(PORTA_BASE_PTR->PCR[2], PORT_PCR_MUX(2)); /*TX*/

	WRITE_REG(UART0->C4, 3);

	WRITE_REG(UART0->BDH, UART_BDH_SBR(bd_div >> 8));

	WRITE_REG(UART0->BDL, UART_BDL_SBR(bd_div));

	WRITE_REG(UART0->C5, UART0_C5_BOTHEDGE_MASK);

	CLEAR_BIT(UART0->C1, (UART0_C1_M_MASK | UART0_C1_PE_MASK));

	WRITE_REG(UART0->C2, (UART0_C2_RE_MASK | UART0_C2_TE_MASK));

}

void PLL_Init()
{
	MCG_BASE_PTR->C2 = (MCG_C2_RANGE0(1) | (0 << MCG_C2_HGO0_SHIFT) | (1 << MCG_C2_EREFS0_SHIFT));
	MCG_BASE_PTR->C1 = (MCG_C1_CLKS(2) | MCG_C1_FRDIV(3));

	while(!(MCG_BASE_PTR->S & MCG_S_OSCINIT0_MASK));

	while(MCG_BASE_PTR->S & MCG_S_IREFST_MASK);

	while(((MCG_BASE_PTR->S & MCG_S_CLKST_MASK) >> MCG_S_CLKST_SHIFT) != 0x02);

	MCG_BASE_PTR->C5 = MCG_C5_PRDIV0(3);

	MCG_BASE_PTR->C6 = MCG_C6_PLLS_MASK | MCG_C6_VDIV0(0);

	while(!(MCG_BASE_PTR->S & MCG_S_PLLST_MASK));

	while(!(MCG_BASE_PTR->S & MCG_S_LOCK0_MASK));

	MCG_BASE_PTR->C1 = MCG_C1_CLKS(0);

	while(((MCG_BASE_PTR->S & MCG_S_CLKST_MASK) >> MCG_S_CLKST_SHIFT) != 0x03);

	SystemCoreClockUpdate();
}
